## boards/adafruit/feather_m4_can_express/Kconfig.feather_m4_can_express
```kconfig
# Copyright (c) 2024
# SPDX-License-Identifier: Apache-2.0

config BOARD_FEATHER_M4_CAN_EXPRESS
	select SOC_SAME51J19A
```

## boards/adafruit/feather_m4_can_express/board.yml
```yaml
board:
  name: feather_m4_can_express
  full_name: Adafruit Feather M4 CAN Express
  vendor: adafruit
  socs:
    - name: same51j19a
```
